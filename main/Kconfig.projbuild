## main/Kconfig.projbuild
```kconfig
menu "Example Configuration"

    config EXAMPLE_STORE_HISTORY
        bool "Store command history in flash"
        default y
        help
            Linenoise line editing library provides functions to save and load
            command history. If this option is enabled, initalizes a FAT filesystem
            and uses it to store command history.

    config EXAMPLE_I2C_MASTER_SCL
        int "SCL GPIO Num"
        default 19 if IDF_TARGET_ESP32
        default 4
        help
            GPIO number for I2C Master clock line.

    config EXAMPLE_I2C_MASTER_SDA
        int "SDA GPIO Num"
        default 18 if IDF_TARGET_ESP32
        default 5
        help
            GPIO number for I2C Master data line.

    choice EXAMPLE_IP_MODE
        prompt "IP Version"
        depends on EXAMPLE_SOCKET_IP_INPUT_STRING
        help
            Example can use either IPV4 or IPV6.

        config EXAMPLE_IPV4
            bool "IPV4"

        config EXAMPLE_IPV6
            bool "IPV6"

    endchoice

    config EXAMPLE_IPV4_ADDR
        string "IPV4 Address"
        default "192.168.0.165"
        depends on EXAMPLE_IPV4
        help
            The example will connect to this IPV4 address.

    config EXAMPLE_IPV6_ADDR
        string "IPV6 Address"
        default "FE80::30AD:E57B:C212:68AD"
        depends on EXAMPLE_IPV6
        help
            The example will connect to this IPV6 address.

    config EXAMPLE_PORT
        int "Port"
        range 0 65535
        default 3333
        help
            The remote port to which the client example will connect to.

    choice EXAMPLE_INTERFACE
        prompt "Interface selection"
        depends on EXAMPLE_IPV6
        help
            Example can use either "Auto" or "User specified".

        config EXAMPLE_IFACE_AUTO
            bool "Auto"

        config EXAMPLE_USER_SPECIFIED_IFACE
            bool "User specified interface"
    endchoice

    config EXAMPLE_USER_SPECIFIED_IFACE_NAME
        string "User specified interface name"
        default "st1"
        depends on EXAMPLE_USER_SPECIFIED_IFACE
        help
            This interface will be used for communication.

    choice EXAMPLE_SOCKET_IP_INPUT
        prompt "Socket example source"
        default EXAMPLE_SOCKET_IP_INPUT_STRING
        help
            Selects the input source of the IP used in the example.

        config EXAMPLE_SOCKET_IP_INPUT_STRING
            bool "From string"

        config EXAMPLE_SOCKET_IP_INPUT_STDIN
            bool "From stdin"
    endchoice

endmenu

menu "I2S PDM Example Configuration"

    choice EXAMPLE_PDM_DIR
        prompt "I2S PDM direction"
        default EXAMPLE_PDM_TX
        help
            Select example PDM direction

        config EXAMPLE_PDM_TX
            bool "PDM TX"
            depends on SOC_I2S_SUPPORTS_PDM_TX
            help
                PDM TX example will play 'twinkle twinkle little star' in three tones.

        config EXAMPLE_PDM_RX
            bool "PDM RX"
            depends on SOC_I2S_SUPPORTS_PDM_RX
            help
                PDM RX example will show the received data from a PDM microphone.
    endchoice

    choice EXAMPLE_PDM_TX_LINE_MODE
        prompt "I2S PDM TX Line Mode"
        depends on EXAMPLE_PDM_TX && SOC_I2S_HW_VERSION_2
        default EXAMPLE_PDM_TX_CODEC
        help
            Decide to output PDM signal into a PDM codec or a low-pass filter

        config EXAMPLE_PDM_TX_CODEC
            bool "Codec line mode"
            help
                Output PDM signal to a PDM codec. The PDM clock signal is mandatory for PDM codec,
                the codec can differentiate the left and right sound channels by sampling data
                on positive or negative edges. That means the data of the left and right channels
                can coexist on a same data line.

        config EXAMPLE_PDM_TX_DAC
            bool "DAC line mode"
            help
                Output PDM signal to a low-pass filter, so that the low-pass filter can restore the PDM
                signal to analog wave. Therefore, each data line can only contains one sound channel,
                if both left and right channels are required, two data lines should be specified as well.
                Normally the PDM signal is not sufficient in DAC line mode.
    endchoice

endmenu

menu "Example TCP-Server Configuration"

    config EXAMPLE_IPV4_SERVER
        bool "IPV4_SERVER"
        default y
        depends on LWIP_IPV4

    config EXAMPLE_IPV6_SERVER
        bool "IPV6_SERVER"
        default n
        select EXAMPLE_CONNECT_IPV6

    config EXAMPLE_SERVER_PORT
        int "Server_Port"
        range 0 65535
        default 3333
        help
            Local port the example server will listen on.

    config EXAMPLE_KEEPALIVE_IDLE
        int "TCP keep-alive idle time(s)"
        default 5
        help
            Keep-alive idle time. In idle time without receiving any data from peer, will send keep-alive probe packet

    config EXAMPLE_KEEPALIVE_INTERVAL
        int "TCP keep-alive interval time(s)"
        default 5
        help
            Keep-alive probe packet interval time.

    config EXAMPLE_KEEPALIVE_COUNT
        int "TCP keep-alive packet retry send counts"
        default 3
        help
            Keep-alive probe packet retry count.
endmenu
```
